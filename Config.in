## Config.in
```kconfig
source "$BR2_EXTERNAL_NORNS_PATH/package/dust/Config.in"
source "$BR2_EXTERNAL_NORNS_PATH/package/libmonome/Config.in"
source "$BR2_EXTERNAL_NORNS_PATH/package/maiden/Config.in"
source "$BR2_EXTERNAL_NORNS_PATH/package/norns/Config.in"
source "$BR2_EXTERNAL_NORNS_PATH/package/sc3-plugins/Config.in"
source "$BR2_EXTERNAL_NORNS_PATH/package/supercollider/Config.in"
source "$BR2_EXTERNAL_NORNS_PATH/package/we/Config.in"
```

## configs/cm3_defconfig
```kconfig
BR2_arm=y
BR2_cortex_a53=y
BR2_ARM_FPU_NEON_VFPV4=y
BR2_OPTIMIZE_2=y
BR2_GLOBAL_PATCH_DIR="$(BR2_EXTERNAL_SIMONTEST_PATH)/patches"
BR2_TOOLCHAIN_EXTERNAL=y
BR2_TARGET_GENERIC_HOSTNAME="simontest"
BR2_SYSTEM_DHCP="eth0"
BR2_ROOTFS_POST_BUILD_SCRIPT="$(BR2_EXTERNAL_SIMONTEST_PATH)/board/cm3/post-build.sh"
BR2_ROOTFS_POST_IMAGE_SCRIPT="$(BR2_EXTERNAL_SIMONTEST_PATH)/board/cm3/post-image.sh"
BR2_ROOTFS_POST_SCRIPT_ARGS="--add-pi3-miniuart-bt-overlay"
BR2_LINUX_KERNEL=y
BR2_LINUX_KERNEL_CUSTOM_TARBALL=y
BR2_LINUX_KERNEL_CUSTOM_TARBALL_LOCATION="https://github.com/raspberrypi/linux/archive/raspberrypi-kernel_1.20171029-1.tar.gz"
BR2_LINUX_KERNEL_PATCH="https://cdn.kernel.org/pub/linux/kernel/projects/rt/4.9/older/patches-4.9.61-rt52.tar.gz"
BR2_LINUX_KERNEL_USE_CUSTOM_CONFIG=y
BR2_LINUX_KERNEL_CUSTOM_CONFIG_FILE="$(BR2_EXTERNAL_SIMONTEST_PATH)/board/cm3/bcm2709stripped_defconfig"
BR2_LINUX_KERNEL_DTS_SUPPORT=y
BR2_LINUX_KERNEL_USE_INTREE_DTS=y
BR2_LINUX_KERNEL_INTREE_DTS_NAME="bcm2710-rpi-3-b bcm2710-rpi-cm3"
BR2_LINUX_KERNEL_USE_CUSTOM_DTS=y
BR2_LINUX_KERNEL_CUSTOM_DTS_PATH="$(BR2_EXTERNAL_SIMONTEST_PATH)/board/cm3/dt-blob.dts"
BR2_LINUX_KERNEL_DTS_OVERLAYS_SUPPORT=y
BR2_PACKAGE_XORG7=y
BR2_PACKAGE_RPI_FIRMWARE=y
BR2_PACKAGE_RPI_FIRMWARE_INSTALL_VCDBG=y
BR2_PACKAGE_DTC=y
BR2_TARGET_ROOTFS_EXT2=y
BR2_TARGET_ROOTFS_EXT2_4=y
# BR2_TARGET_ROOTFS_TAR is not set
BR2_PACKAGE_HOST_DOSFSTOOLS=y
BR2_PACKAGE_HOST_GENIMAGE=y
BR2_PACKAGE_HOST_MTOOLS=y
BR2_PACKAGE_SUPERCOLLIDER=y
```

## configs/norns_defconfig
```kconfig
BR2_arm=y
BR2_cortex_a53=y
BR2_ARM_FPU_NEON_VFPV4=y
BR2_CCACHE=y
BR2_OPTIMIZE_2=y
BR2_GLOBAL_PATCH_DIR="$(BR2_EXTERNAL_NORNS_PATH)/patches"
BR2_TOOLCHAIN_EXTERNAL=y
BR2_TARGET_GENERIC_HOSTNAME="norns"
BR2_TARGET_GENERIC_ISSUE="Welcome to Norns"
BR2_INIT_SYSTEMD=y
BR2_ROOTFS_OVERLAY="$(BR2_EXTERNAL_NORNS_PATH)/board/norns/rootfs-overlay"
BR2_ROOTFS_POST_BUILD_SCRIPT="$(BR2_EXTERNAL_NORNS_PATH)/board/norns/post-build.sh"
BR2_ROOTFS_POST_IMAGE_SCRIPT="$(BR2_EXTERNAL_NORNS_PATH)/board/norns/post-image.sh"
BR2_LINUX_KERNEL=y
BR2_LINUX_KERNEL_CUSTOM_TARBALL=y
BR2_LINUX_KERNEL_CUSTOM_TARBALL_LOCATION="https://github.com/monome/linux/archive/dc46f6fbd2ab81b7f79032481cdb407eb7e2c5b3.tar.gz"
BR2_LINUX_KERNEL_DEFCONFIG="norns"
BR2_LINUX_KERNEL_DTS_SUPPORT=y
BR2_LINUX_KERNEL_CUSTOM_DTS_PATH="$(BR2_EXTERNAL_NORNS_PATH)/board/norns/dt-blob.dts"
BR2_PACKAGE_ALSA_UTILS=y
BR2_PACKAGE_ALSA_UTILS_AMIXER=y
BR2_PACKAGE_ALSA_UTILS_APLAY=y
BR2_PACKAGE_ALSA_UTILS_SPEAKER_TEST=y
BR2_PACKAGE_FB_TEST_APP=y
BR2_PACKAGE_LINUX_FIRMWARE=y
BR2_PACKAGE_LINUX_FIRMWARE_RTL_81XX=y
BR2_PACKAGE_RPI_FIRMWARE=y
BR2_PACKAGE_RPI_FIRMWARE_INSTALL_VCDBG=y
BR2_PACKAGE_DTC=y
BR2_PACKAGE_FFTW_PRECISION_SINGLE=y
BR2_PACKAGE_LIBPTHREAD_STUBS=y
BR2_PACKAGE_XUTIL_UTIL_MACROS=y
# BR2_PACKAGE_IFUPDOWN_SCRIPTS is not set
BR2_PACKAGE_NETWORK_MANAGER=y
BR2_PACKAGE_NETWORK_MANAGER_TUI=y
BR2_PACKAGE_WPA_SUPPLICANT=y
BR2_PACKAGE_WPA_SUPPLICANT_EAP=y
BR2_PACKAGE_WPA_SUPPLICANT_CLI=y
BR2_PACKAGE_WPA_SUPPLICANT_DBUS_NEW=y
BR2_PACKAGE_WPA_SUPPLICANT_DBUS_INTROSPECTION=y
# BR2_PACKAGE_SYSTEMD_HOSTNAMED is not set
# BR2_PACKAGE_SYSTEMD_MYHOSTNAME is not set
# BR2_PACKAGE_SYSTEMD_NETWORKD is not set
# BR2_PACKAGE_SYSTEMD_RESOLVED is not set
# BR2_PACKAGE_SYSTEMD_VCONSOLE is not set
BR2_PACKAGE_UTIL_LINUX_RFKILL=y
BR2_TARGET_ROOTFS_EXT2=y
BR2_TARGET_ROOTFS_EXT2_4=y
BR2_TARGET_ROOTFS_EXT2_SIZE="200M"
# BR2_TARGET_ROOTFS_TAR is not set
BR2_PACKAGE_HOST_DOSFSTOOLS=y
BR2_PACKAGE_HOST_GENIMAGE=y
BR2_PACKAGE_HOST_MTOOLS=y
BR2_PACKAGE_DUST=y
BR2_PACKAGE_NORNS=y
```

## package/crow-studies/Config.in
```kconfig
config BR2_PACKAGE_CROW_STUDIES
	bool "crow-studies"
	select BR2_PACKAGE_DUST

	help
	  crow studies

	  https://monome.org/docs/crow/norns
```

## package/dust/Config.in
```kconfig
config BR2_PACKAGE_DUST
	bool "dust"
	select BR2_PACKAGE_SC3_PLUGINS
	select BR2_PACKAGE_SUPERCOLLIDER

	help
	  norns incantations

	  https://github.com/monome/dust
```

## package/libmonome/Config.in
```kconfig
config BR2_PACKAGE_LIBMONOME
	bool "libmonome"
	depends on BR2_TOOLCHAIN_HAS_THREADS
	select BR2_PACKAGE_LIBLO
       help
	  libmonome is a library for easy interaction with monome
	  devices. It currently runs on Linux (on which it is
	  primarily developed), OpenBSD, and Darwin/OS X.

	  https://github.com/monome/libmonome

comment "libmonome needs a toolchain w/ threads"
	depends on !BR2_TOOLCHAIN_HAS_THREADS
```

## package/maiden/Config.in
```kconfig
config BR2_PACKAGE_MAIDEN
	bool "maiden"
	select BR2_PACKAGE_CA_CERTIFICATES
	select BR2_PACKAGE_DUST

	help
	  Web based editor and repl for norns

	  https://github.com/monome/maiden
```

## package/norns/Config.in
```kconfig
config BR2_PACKAGE_NORNS
	bool "norns"
	depends on BR2_TOOLCHAIN_HAS_THREADS
	select BR2_PACKAGE_AVAHI
	select BR2_PACKAGE_AVAHI_DAEMON
	select BR2_PACKAGE_AVAHI_LIBDNSSD_COMPATIBILITY
	select BR2_PACKAGE_BOOST
	select BR2_PACKAGE_CAIRO
	select BR2_PACKAGE_CAIRO_PNG
	select BR2_PACKAGE_LIBEVDEV
	select BR2_PACKAGE_LIBLO
	select BR2_PACKAGE_LIBMONOME
	select BR2_PACKAGE_LUA
	select BR2_PACKAGE_NANOMSG
	select BR2_PACKAGE_SC3_PLUGINS
	select BR2_PACKAGE_SUPERCOLLIDER

	help
	  norns is many sound instruments

	  https://github.com/monome/norns

comment "norns needs a toolchain w/ threads"
	depends on !BR2_TOOLCHAIN_HAS_THREADS
```

## package/sc3-plugins/Config.in
```kconfig
config BR2_PACKAGE_SC3_PLUGINS
        bool "sc3_plugins"
        select BR2_PACKAGE_SUPERCOLLIDER
        select BR2_PACKAGE_FFTW
        select BR2_PACKAGE_FFTW_PRECISION_SINGLE
        help
          A community collection of unit generator plugins for
          SuperCollider. Extends the functionality of SuperCollider
          by additional UGens.

          https://supercollider.github.io/sc3-plugins
```

## package/softcut-studies/Config.in
```kconfig
config BR2_PACKAGE_SOFTCUT_STUDIES
	bool "softcut-studies"
	select BR2_PACKAGE_DUST

	help
	  softcut studies

	  https://github.com/monome/softcut-studies
```

## package/supercollider/Config.in
```kconfig
config BR2_PACKAGE_SUPERCOLLIDER
        bool "supercollider"
        depends on BR2_PACKAGE_XORG7
        depends on BR2_TOOLCHAIN_HAS_THREADS
        select BR2_PACKAGE_JACK2
        select BR2_PACKAGE_READLINE
        select BR2_PACKAGE_FFTW
        select BR2_PACKAGE_LIBSNDFILE
        select BR2_PACKAGE_XLIB_LIBX11
        select BR2_PACKAGE_XLIB_LIBXT
        help
          SuperCollider is a platform for audio synthesis and
          algorithmic composition, used by musicians, artists,
          and researchers working with sound.

          https://supercollider.github.io

comment "supercollider needs a toolchain w/ threads"
	depends on !BR2_TOOLCHAIN_HAS_THREADS
```

## package/we/Config.in
```kconfig
config BR2_PACKAGE_WE
	bool "we"
	select BR2_PACKAGE_DUST

	help
	  norns collected and collaborative projects

	  https://github.com/monome/we
```
